## esp32_firmware/production/sdkconfig.defaults
```kconfig
# WiFi Configuration
CONFIG_ESP32_WIFI_STATIC_RX_BUFFER_NUM=10
CONFIG_ESP32_WIFI_DYNAMIC_RX_BUFFER_NUM=32
CONFIG_ESP32_WIFI_DYNAMIC_TX_BUFFER_NUM=32
CONFIG_ESP32_WIFI_AMPDU_TX_ENABLED=y
CONFIG_ESP32_WIFI_TX_BUFFER=y
CONFIG_ESP32_WIFI_AMPDU_RX_ENABLED=y

# LWIP Configuration
CONFIG_LWIP_TCP_MSS=1440
CONFIG_LWIP_TCP_SND_BUF_DEFAULT=5744
CONFIG_LWIP_TCP_WND_DEFAULT=5744
CONFIG_LWIP_TCP_RECVMBOX_SIZE=6
CONFIG_LWIP_UDP_RECVMBOX_SIZE=6
CONFIG_LWIP_TCPIP_RECVMBOX_SIZE=32

# Main task stack size
CONFIG_ESP_MAIN_TASK_STACK_SIZE=8192

# MQTT Configuration
CONFIG_MQTT_TASK_STACK_SIZE=6144
CONFIG_MQTT_BUFFER_SIZE=1024

# Enable SNTP
CONFIG_LWIP_SNTP=y

# FreeRTOS Configuration
CONFIG_FREERTOS_HZ=1000

# Serial Console Configuration
CONFIG_ESP_CONSOLE_UART_DEFAULT=y
CONFIG_ESP_CONSOLE_UART_NUM=0
CONFIG_ESP_CONSOLE_UART_BAUDRATE=115200

# Log Configuration
CONFIG_LOG_DEFAULT_LEVEL_INFO=y
CONFIG_LOG_DEFAULT_LEVEL=3

# Partition Table
CONFIG_PARTITION_TABLE_SINGLE_APP=y
```
